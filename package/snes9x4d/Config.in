## package/snes9x4d/Config.in
```kconfig
config BR2_PACKAGE_SNES9X4D
        bool "snes9x4d"
	depends on BR2_INSTALL_LIBSTDCPP
        help
          SNES9x for Dingux emulator - ported to LF1000

comment "Snes9x4D needs a toolchain w/ C++"
	depends on !BR2_INSTALL_LIBSTDCPP
```

## package/st-sdl/Config.in
```kconfig
config BR2_PACKAGE_ST_SDL
        bool "st-sdl"
        help
          Terminal emulator with a graphical keyboard, adapted for LF1000
```
